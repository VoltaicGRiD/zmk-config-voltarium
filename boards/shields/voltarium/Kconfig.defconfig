## boards/shields/voltarium/Kconfig.defconfig
```kconfig
if SHIELD_VOLTARIUM_LEFT

config ZMK_KEYBOARD_NAME
	default "Voltarium"
	
config ZMK_SPLIT_ROLE_CENTRAL
    default y

endif

if SHIELD_VOLTARIUM_RIGHT

config ZMK_SPLIT_ROLE_CENTRAL
    default n

endif

if SHIELD_VOLTARIUM_LEFT || SHIELD_VOLTARIUM_RIGHT

config ZMK_SPLIT
    default y

endif
```

## boards/shields/voltarium/Kconfig.shield
```kconfig
config SHIELD_VOLTARIUM_LEFT
	def_bool $(shields_list_contains, voltarium_left)

config SHIELD_VOLTARIUM_RIGHT
	def_bool $(shields_list_contains, voltarium_right)
```

## boards/shields/voltarium_left/Kconfig.defconfig
```kconfig
if SHIELD_VOLTARIUM_LEFT

config ZMK_KEYBOARD_NAME
	default "Voltarium (Left)"
	
endif
```
